## br.LTPPxG2/Config.in
```kconfig
source "$BR2_EXTERNAL_LTPPxG2_PATH/boot/xboot/Config.in"
source "$BR2_EXTERNAL_LTPPxG2_PATH/boot/bnoos/Config.in"
source "$BR2_EXTERNAL_LTPPxG2_PATH/linux/Config.in"
source "$BR2_EXTERNAL_LTPPxG2_PATH/package/spmake/Config.in"
source "$BR2_EXTERNAL_LTPPxG2_PATH/package/xboot-sptools/Config.in"
source "$BR2_EXTERNAL_LTPPxG2_PATH/package/spisp/Config.in"
```

## br.LTPPxG2/boot/bnoos/Config.in
```kconfig
config BR2_TARGET_BNOOS
    bool "Plus1 arm926 code"
    default y
    depends on BR2_arm926t
    help
        Plus1 arm926 standalone application example
	Bnoos https://github.com/tibbotech/plus1_Bnoos

config BR2_TARGET_BNOOS_VERSION
	string "Custom B-CPU noos FW version"
	help
	  This option allows to use a specific official versions
```

## br.LTPPxG2/boot/xboot/Config.in
```kconfig
config BR2_TARGET_XBOOT
    bool "Plus1 Xboot"
    default y
    select BR2_TARGET_BNOOS
    depends on BR2_arm926t
    help
	1-level (software) boot code after 0-level (hardware) ROM.
	Running at arm926 co-processor:
	1) init DRAM
	2) starts U-Boot from USB|MMC|SPI|NAND
	XBoot https://github.com/tibbotech/plus1_xboot

if BR2_TARGET_XBOOT

choice

    prompt "Boot from"
    default BR2_TARGET_XBOOT_EMMC
    help
	Select boot memory source

config BR2_TARGET_XBOOT_EMMC
    bool "EMMC"

config BR2_TARGET_XBOOT_NAND
    bool "NAND"

endchoice

config BR2_TARGET_XBOOT_CONFIG
	string
	default	"q628_Rev2_EMMC_defconfig"	if	BR2_TARGET_XBOOT_EMMC
	default	"q628_Rev2_SPINAND_defconfig"	if	BR2_TARGET_XBOOT_NAND

endif
```

## br.LTPPxG2/configs/LTPPxG2_defconfig
```kconfig
# Architecture
BR2_arm=y
BR2_cortex_a7=y
BR2_ARM_FPU_VFPV4=y

# Kernel Header Options
#
BR2_KERNEL_HEADERS_AS_KERNEL=y
BR2_PACKAGE_HOST_LINUX_HEADERS_CUSTOM_5_10=y
BR2_PACKAGE_LINUX_HEADERS=y

BR2_ROOTFS_DEVICE_CREATION_DYNAMIC_DEVTMPFS=y

BR2_TARGET_ENABLE_ROOT_LOGIN=y
BR2_TARGET_GENERIC_ROOT_PASSWD="123"

# Kernel
#
BR2_LINUX_KERNEL=y
BR2_LINUX_KERNEL_CUSTOM_GIT=y
BR2_LINUX_KERNEL_CUSTOM_REPO_URL="https://github.com/tibbotech/plus1_kernel.git"
BR2_LINUX_KERNEL_CUSTOM_REPO_VERSION="89be367a2ecd9574b8b3c8878198368b20ed9962"
BR2_LINUX_KERNEL_VERSION="89be367a2ecd9574b8b3c8878198368b20ed9962"
BR2_LINUX_KERNEL_PATCH=""
BR2_LINUX_KERNEL_USE_DEFCONFIG=y
BR2_LINUX_KERNEL_DEFCONFIG="sp7021_chipC_ltpp3g2"
BR2_LINUX_KERNEL_CONFIG_FRAGMENT_FILES=""
BR2_LINUX_KERNEL_UIMAGE=y
BR2_LINUX_KERNEL_GZIP=y
BR2_LINUX_KERNEL_DTS_SUPPORT=y
BR2_LINUX_KERNEL_INTREE_DTS_NAME="sp7021-ltpp3g2revD"
BR2_LINUX_KERNEL_DTB_OVERLAY_SUPPORT=y


BR2_TARGET_ROOTFS_CPIO=y
BR2_TARGET_ROOTFS_CPIO_NONE=y
BR2_TARGET_ROOTFS_EXT2=y
BR2_TARGET_ROOTFS_EXT2_4=y
BR2_TARGET_ROOTFS_INITRAMFS=y
BR2_TARGET_ROOTFS_SQUASHFS=y
BR2_TARGET_ROOTFS_SQUASHFS_PAD=y
BR2_TARGET_ROOTFS_SQUASHFS4_GZIP=y
BR2_TARGET_ROOTFS_TAR=y
BR2_TARGET_ROOTFS_UBI=y
BR2_TARGET_ROOTFS_UBI_PEBSIZE=0x20000
BR2_TARGET_ROOTFS_UBI_SUBSIZE=512
# BR2_TARGET_ROOTFS_UBI_USE_CUSTOM_CONFIG is not set
BR2_TARGET_ROOTFS_UBI_OPTS=""
BR2_TARGET_ROOTFS_UBIFS=y
BR2_TARGET_ROOTFS_UBIFS_LEBSIZE=0x1f800
BR2_TARGET_ROOTFS_UBIFS_MINIOSIZE=0x800
BR2_TARGET_ROOTFS_UBIFS_MAXLEBCNT=2048
BR2_TARGET_ROOTFS_UBIFS_RT_LZO=y
BR2_TARGET_ROOTFS_UBIFS_NONE=y
BR2_TARGET_ROOTFS_UBIFS_OPTS=""

BR2_TARGET_UBOOT=y
BR2_TARGET_UBOOT_BUILD_SYSTEM_KCONFIG=y
BR2_TARGET_UBOOT_CUSTOM_GIT=y
BR2_TARGET_UBOOT_CUSTOM_REPO_URL="https://github.com/tibbotech/plus1_uboot.git"
BR2_TARGET_UBOOT_CUSTOM_REPO_VERSION="5148e6075b11a8ec71c8e370cfbf79441907b232"
BR2_TARGET_UBOOT_VERSION="5148e6075b11a8ec71c8e370cfbf79441907b232"
BR2_TARGET_UBOOT_PATCH=""
BR2_TARGET_UBOOT_USE_DEFCONFIG=y
# BR2_TARGET_UBOOT_USE_CUSTOM_CONFIG is not set
BR2_TARGET_UBOOT_BOARD_DEFCONFIG="sp7021_tppg2"
BR2_TARGET_UBOOT_CONFIG_FRAGMENT_FILES=""
BR2_TARGET_UBOOT_NEEDS_DTC=y
BR2_TARGET_UBOOT_NEEDS_PYTHON=y
BR2_TARGET_UBOOT_NEEDS_PYTHON2=y
BR2_TARGET_UBOOT_NEEDS_PYLIBFDT=y
BR2_TARGET_UBOOT_FORMAT_BIN=y
# BR2_TARGET_UBOOT_FORMAT_DTB_BIN is not set
BR2_TARGET_UBOOT_CUSTOM_DTS_PATH=""
BR2_TARGET_UBOOT_CUSTOM_MAKEOPTS=""

BR2_PACKAGE_HOST_DTC=y
BR2_PACKAGE_HOST_E2FSPROGS=y
BR2_PACKAGE_HOST_KMOD=y

BR2_PACKAGE_HOST_MKPASSWD=y

# fix later
#BR2_ROOTFS_POST_IMAGE_SCRIPT="$(O)/images/run_spmake.sh"
#BR2_ROOTFS_POST_SCRIPT_ARGS="$(O)/images"

BR2_PACKAGE_OVERRIDE_FILE="$(BR2_EXTERNAL)/local.mk"
BR2_PACKAGE_SPMAKE=y
```

## br.LTPPxG2/configs/LTPPxG2a5_defconfig
```kconfig
# arch
BR2_arm=y
BR2_arm926t=y

# Toolchain
BR2_KERNEL_HEADERS_5_4=y

# Bootloaders
BR2_TARGET_XBOOT=y
BR2_TARGET_XBOOT_VERSION="8c36569de26a7b6180e51caff315c458e241c648"
BR2_TARGET_XBOOT_DRAM_VERSION="9f94d93c2c739f3a78dfd44339b5284e39ccf401"

# B-CPU noos version
BR2_TARGET_BNOOS_VERSION="aa5bc16415a6c54b3128bccdf74eae21e3fac449"
```

## br.LTPPxG2/linux/Config.in
```kconfig
choice
    prompt "Plus1 Linux kernel DTS name"
    default DTS_LTPP3G2
    depends on BR2_cortex_a7
    help
	DTS to use with the board

config DTS_LTPP3G2
    bool "LTPP3G2 Board"

config DTS_EV
    bool "EV Board"

endchoice

config BR2_LINUX_KERNEL_INTREE_DTS_NAME
	string
	default	"sp7021-ltpp3g2revD"	if	DTS_LTPP3G2
	default	"sp7021-ev"		if	DTS_EV
```

## br.LTPPxG2/package/spisp/Config.in
```kconfig
config BR2_PACKAGE_SPISP
    bool "Plus1 ISPBOOOT assembly helper apps"
    default y
    depends on BR2_cortex_a7
    depends on BR2_PACKAGE_SPMAKE
    help
	ISPBOOOT.BIN assembly helper scripts

config BR2_PACKAGE_SPISP_VERSION
	string "Custom spisp version"
	help
	  This option allows to use a specific official versions
```

## br.LTPPxG2/package/spmake/Config.in
```kconfig
config BR2_PACKAGE_SPMAKE
    bool "Plus1 ISPBOOOT assembly Makefile"
    default y
    depends on BR2_cortex_a7
    select BR2_PACKAGE_XBOOT_SPTOOLS
    select BR2_PACKAGE_SPISP
    help
	sp7021 image makefile assembles ISP image from the parts
```

## br.LTPPxG2/package/xboot-sptools/Config.in
```kconfig
config BR2_PACKAGE_XBOOT_SPTOOLS
    bool "Plus1 xboot-tools"
    default y
    depends on BR2_PACKAGE_SPMAKE
    help
	ISPBOOOT assemble helper scripts: add_xhdr, tcpsum

config BR2_PACKAGE_XBOOT_VERSION
	string "Custom xboot version"
	help
	  This option allows to use a specific official versions
```
